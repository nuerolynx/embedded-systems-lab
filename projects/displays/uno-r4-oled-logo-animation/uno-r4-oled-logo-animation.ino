#include <Arduino.h>
#include <U8g2lib.h>
#include <math.h>

/*
CLK  -> A1
MOSI -> A2
CS   -> 8
DC   -> 4
RES  -> 5
*/

U8G2_SSD1306_128X64_NONAME_F_4W_SW_SPI display(
  U8G2_R0,
  A1,   // CLK
  A2,   // MOSI
  8,    // CS
  4,    // DC
  5     // RESET
);

// =======================================================
// PASTE YOUR *FULL* IMAGE2CPP ARRAY HERE (DO NOT LEAVE EMPTY)
// Format: 128x64 | 1-bit vertical bytes (LSB=top)
// =======================================================
const unsigned char IMG_2654[] PROGMEM = {
  0x00, 0x00, 0x00, 0x00, 0x00, 0x00, 0x00, 0x00, 0x00, 0x00, 0x00, 0x00, 0x00, 0x00, 0x00, 0x00,
  0x00, 0x00, 0x00, 0x00, 0x00, 0x00, 0x00, 0x00, 0x00, 0x00, 0x00, 0x00, 0x00, 0x00, 0x00, 0x00,
  0x00, 0x00, 0x00, 0x00, 0x00, 0x00, 0x00, 0x00, 0x00, 0x00, 0x00, 0x00, 0x00, 0x00, 0x00, 0x00,
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  0x00, 0x00, 0x00, 0x00, 0x00, 0x00, 0x00, 0x00, 0x00, 0x00, 0x00, 0x00, 0x00, 0x00, 0x00, 0x00,
};

// If this fires, your array is empty (this is EXACTLY why you got “Got: 0 bytes”)
static_assert(sizeof(IMG_2654) > 0, "IMG_2654 is empty. Paste the full Image2CPP byte array.");

// -------- buffers --------
static uint8_t xbm[1024];                 // 128x64 XBM (max)
static uint8_t logoBuf[(64 * 48) / 8];    // up to 64x48 logo buffer (1bpp)

// -------- helpers --------
static void convertVerticalLSBTop_to_XBM(const uint8_t* src, uint8_t* dst, uint8_t w, uint8_t h) {
  memset(dst, 0, (w * h) / 8);

  const uint8_t pages = h / 8;
  for (uint8_t x = 0; x < w; x++) {
    for (uint8_t page = 0; page < pages; page++) {
      // On UNO R4, PROGMEM acts like normal flash; pgm_read_byte is still safe
      uint8_t b = pgm_read_byte(&src[x + (page * w)]);
      for (uint8_t bit = 0; bit < 8; bit++) {
        uint8_t y = (page * 8) + bit;
        if ((b >> bit) & 0x01) {
          uint16_t outIndex = (y * (w / 8)) + (x / 8);
          dst[outIndex] |= (1 << (x % 8)); // XBM bit order
        }
      }
    }
  }
}

static inline bool xbmGetPixel(const uint8_t* bmp, uint8_t w, uint8_t x, uint8_t y) {
  uint16_t idx = (y * (w / 8)) + (x / 8);
  uint8_t  bit = (1 << (x % 8));
  return (bmp[idx] & bit) != 0;
}

static inline void bufSetPixel(uint8_t* buf, uint8_t w, uint8_t x, uint8_t y, bool on) {
  uint16_t idx = (y * (w / 8)) + (x / 8);
  uint8_t  bit = (1 << (x % 8));
  if (on) buf[idx] |= bit;
  else    buf[idx] &= ~bit;
}

static inline bool bufGetPixel(const uint8_t* buf, uint8_t w, uint8_t x, uint8_t y) {
  uint16_t idx = (y * (w / 8)) + (x / 8);
  uint8_t  bit = (1 << (x % 8));
  return (buf[idx] & bit) != 0;
}

// Build a scaled copy of your logo into a small buffer (fast to rotate)
static void buildScaledLogoBuffer(
  uint8_t* dstBuf, uint8_t dstW, uint8_t dstH,
  const uint8_t* srcXbm, uint8_t srcW, uint8_t srcH
) {
  memset(dstBuf, 0, (dstW * dstH) / 8);

  for (uint8_t y = 0; y < dstH; y++) {
    uint8_t sy = (uint32_t)y * srcH / dstH;
    for (uint8_t x = 0; x < dstW; x++) {
      uint8_t sx = (uint32_t)x * srcW / dstW;
      if (xbmGetPixel(srcXbm, srcW, sx, sy)) {
        bufSetPixel(dstBuf, dstW, x, y, true);
      }
    }
  }
}

// Draw the logo rotated into a square box (boxSize x boxSize)
static void drawRotatedLogo(
  int16_t dstX, int16_t dstY,
  uint8_t boxSize,
  const uint8_t* srcBuf,
  uint8_t srcW, uint8_t srcH,
  float degrees
) {
  float rad = degrees * 0.01745329252f; // PI/180
  float c = cosf(rad);
  float s = sinf(rad);

  float cxD = (boxSize - 1) * 0.5f;
  float cyD = (boxSize - 1) * 0.5f;

  float cxS = (srcW - 1) * 0.5f;
  float cyS = (srcH - 1) * 0.5f;

  for (uint8_t y = 0; y < boxSize; y++) {
    for (uint8_t x = 0; x < boxSize; x++) {
      float dx = x - cxD;
      float dy = y - cyD;

      // inverse rotation mapping (dest -> source)
      float sx =  (dx * c) + (dy * s) + cxS;
      float sy = (-dx * s) + (dy * c) + cyS;

      int isx = (int)lroundf(sx);
      int isy = (int)lroundf(sy);

      if (isx >= 0 && isx < srcW && isy >= 0 && isy < srcH) {
        if (bufGetPixel(srcBuf, srcW, (uint8_t)isx, (uint8_t)isy)) {
          display.drawPixel(dstX + x, dstY + y);
        }
      }
    }
  }
}

void setup() {
  Serial.begin(115200);
  delay(200);

  display.begin();

  const size_t n = sizeof(IMG_2654);
  Serial.print("IMG_2654 bytes = ");
  Serial.println((unsigned long)n);

  uint8_t w = 0, h = 64;

  if (n == 512) {
    w = 64;  h = 64;
  } else if (n == 1024) {
    w = 128; h = 64;
  } else {
    display.clearBuffer();
    display.setFont(u8g2_font_6x12_tr);
    display.drawStr(0, 12, "Bitmap size wrong");
    display.drawStr(0, 26, "Expected 512 or 1024");
    char buf[32];
    snprintf(buf, sizeof(buf), "Got: %lu bytes", (unsigned long)n);
    display.drawStr(0, 40, buf);
    display.sendBuffer();
    while (true) { delay(1000); }
  }

  // Convert your Image2CPP bytes -> XBM pixels
  convertVerticalLSBTop_to_XBM(IMG_2654, xbm, w, h);

  // Same sizing logic you had (logo + text)
  uint8_t logoW = (w == 128) ? 64 : 48;
  uint8_t logoH = (w == 128) ? 32 : 48;

  // Pre-scale into logoBuf once (then rotate that)
  buildScaledLogoBuffer(logoBuf, logoW, logoH, xbm, w, h);

  // Rotate inside a square so it doesn’t clip
  const uint8_t boxSize = 48;                 // spinning box
  int16_t logoX = (128 - boxSize) / 2;
  int16_t logoY = 0;

  // Text stays still
  const char* brand = "Nuerolynx";
  display.setFont(u8g2_font_7x14_tr);         // non-bold (your preference)
  int16_t tw = display.getStrWidth(brand);
  int16_t tx = (128 - tw) / 2;

  int16_t ty = logoY + boxSize + 14;
  if (ty > 63) ty = 63;

  // ---- SPIN 360° ONCE ----
  for (int a = 0; a <= 360; a += 12) {         // 6 = smoother; use 12 for faster
    display.clearBuffer();

    // logo only spins
    drawRotatedLogo(logoX, logoY, boxSize, logoBuf, logoW, logoH, (float)a);

    // text stays still
    display.drawStr(tx, ty, brand);

    display.sendBuffer();
    delay(10);                                 // speed control
  }

  // Final static frame
  display.clearBuffer();
  drawRotatedLogo(logoX, logoY, boxSize, logoBuf, logoW, logoH, 0.0f);
  display.drawStr(tx, ty, brand);
  display.sendBuffer();
}

void loop() {}
